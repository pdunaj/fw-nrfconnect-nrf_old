## samples/nrf52_desktop/Kconfig
```kconfig
#
# Copyright (c) 2018 Nordic Semiconductor
#
# SPDX-License-Identifier: BSD-5-Clause-Nordic
#

menu "nRF52 Desktop"
rsource "src/drivers/Kconfig"
rsource "src/events/Kconfig"
rsource "src/modules/Kconfig"
rsource "src/services/Kconfig"
endmenu

menu "Zephyr kernel"
source "$ZEPHYR_BASE/Kconfig.zephyr"
endmenu
```

## samples/nrf52_desktop/boards/arm/nrf52_desktop_dongle/Kconfig
```kconfig
# Kconfig - nRF52 Desktop dongle board configuration
#
# Copyright (c) 2016 Nordic Semiconductor ASA
#
# SPDX-License-Identifier: Apache-2.0

if BOARD_NRF52_DESKTOP_DONGLE

config  GPIO_AS_PINRESET
	bool "GPIO as pin reset (reset button)"
	default y

endif # BOARD_NRF52_DESKTOP_DONGLE
```

## samples/nrf52_desktop/boards/arm/nrf52_desktop_dongle/Kconfig.board
```kconfig
# Kconfig - nRF52 Desktop dongle board configuration
#
# Copyright (c) 2018 Nordic Semiconductor ASA
#
# SPDX-License-Identifier: Apache-2.0

config  BOARD_NRF52_DESKTOP_DONGLE
	bool "nRF52 Desktop dongle"
	depends on SOC_NRF52832_QFAA
```

## samples/nrf52_desktop/boards/arm/nrf52_desktop_keyboard/Kconfig.board
```kconfig
# Kconfig - nRF52 Desktop keyboard board configuration
#
# Copyright (c) 2018 Nordic Semiconductor ASA
#
# SPDX-License-Identifier: Apache-2.0

config  BOARD_NRF52_DESKTOP_KEYBOARD
	bool "nRF52 Desktop keyboard"
	depends on SOC_NRF52832_QFAA
```

## samples/nrf52_desktop/boards/arm/nrf52_desktop_keyboard/nrf52_desktop_keyboard_defconfig
```kconfig
CONFIG_ARM=y
CONFIG_SOC_FAMILY_NRF=y
CONFIG_SOC_SERIES_NRF52X=y
CONFIG_SOC_NRF52832_QFAA=y
CONFIG_BOARD_NRF52_DESKTOP_KEYBOARD=y

# Enable MPU
CONFIG_ARM_MPU_NRF52X=y

# enable uart driver
CONFIG_SERIAL=y
CONFIG_UART_NRFX=y

# enable console
CONFIG_CONSOLE=y
CONFIG_UART_CONSOLE=y

# additional board options
CONFIG_GPIO_AS_PINRESET=y

# bluetooth
CONFIG_BT=y
CONFIG_BT_CTLR=y

CONFIG_BT_DEVICE_NAME="Keyboard nRF52 Desktop"
```

## samples/nrf52_desktop/boards/arm/nrf52_desktop_mouse/Kconfig
```kconfig
# Kconfig - nRF52 Desktop mouse board configuration
#
# Copyright (c) 2018 Nordic Semiconductor ASA
#
# SPDX-License-Identifier: Apache-2.0

if BOARD_NRF52_DESKTOP_MOUSE

config  GPIO_AS_PINRESET
	bool "GPIO as pin reset (reset button)"
	default y

endif # BOARD_NRF52_DESKTOP_MOUSE
```

## samples/nrf52_desktop/boards/arm/nrf52_desktop_mouse/Kconfig.board
```kconfig
# Kconfig - nRF52 Desktop mouse board configuration
#
# Copyright (c) 2018 Nordic Semiconductor ASA
#
# SPDX-License-Identifier: Apache-2.0

config  BOARD_NRF52_DESKTOP_MOUSE
	bool "nRF52 Desktop mouse"
	depends on SOC_NRF52832_QFAA
```

## samples/nrf52_desktop/sample.yaml
```yaml
sample:
  description: TBD
  name: TBD
tests:
  test:
    harness: bluetooth
    platform_whitelist: nrf52_desktop_dongle nrf52_desktop_mouse nrf52_desktop_keyboard
    tags: bluetooth
```

## samples/nrf52_desktop/src/drivers/Kconfig
```kconfig
menu "Drivers"

menu "Board driver"

config DESKTOP_SYS_LOG_BOARD_DRIVER_LEVEL
	int "Board driver log level"
	depends on SYS_LOG
	default 2
	range 0 4
	help
	  Sets log level for board driver.
	  Levels are:
	  - 0 OFF, do not write
	  - 1 ERROR, only write SYS_LOG_ERR
	  - 2 WARNING, write SYS_LOG_WRN in addition to previous level
	  - 3 INFO, write SYS_LOG_INF in addition to previous levels
	  - 4 DEBUG, write SYS_LOG_DBG in addition to previous levels
endmenu


menu "Keyboard driver"

config DESKTOP_SYS_LOG_KEYBOARD_DRIVER_LEVEL
	int "Keyboard driver log level"
	depends on SYS_LOG
	default 2
	range 0 4
	help
	  Sets log level for keyboard driver.
	  Levels are:
	  - 0 OFF, do not write
	  - 1 ERROR, only write SYS_LOG_ERR
	  - 2 WARNING, write SYS_LOG_WRN in addition to previous level
	  - 3 INFO, write SYS_LOG_INF in addition to previous levels
	  - 4 DEBUG, write SYS_LOG_DBG in addition to previous levels
endmenu


menu "LIS3DH accelerometer driver"

config DESKTOP_SYS_LOG_LIS3DH_DRIVER_LEVEL
	int "LIS3DH driver log level"
	depends on SYS_LOG
	default 2
	range 0 4
	help
	  Sets log level for LIS3DH driver.
	  Levels are:
	  - 0 OFF, do not write
	  - 1 ERROR, only write SYS_LOG_ERR
	  - 2 WARNING, write SYS_LOG_WRN in addition to previous level
	  - 3 INFO, write SYS_LOG_INF in addition to previous levels
	  - 4 DEBUG, write SYS_LOG_DBG in addition to previous levels
endmenu


menu "Mouse driver"

config DESKTOP_SYS_LOG_MOUSE_DRIVER_LEVEL
	int "Mouse driver log level"
	depends on SYS_LOG
	default 2
	range 0 4
	help
	  Sets log level for mouse driver.
	  Levels are:
	  - 0 OFF, do not write
	  - 1 ERROR, only write SYS_LOG_ERR
	  - 2 WARNING, write SYS_LOG_WRN in addition to previous level
	  - 3 INFO, write SYS_LOG_INF in addition to previous levels
	  - 4 DEBUG, write SYS_LOG_DBG in addition to previous levels
endmenu
endmenu
```

## samples/nrf52_desktop/src/events/Kconfig
```kconfig
menu "Event Manager"

config DESKTOP_EVENT_MANAGER_SHOW_EVENTS
	bool "Show events"
	default y
	help
	  This option controls if events are printed to console.

config DESKTOP_EVENT_MANAGER_SHOW_EVENT_HANDLERS
	bool "Show event handlers"
	default n
	help
	  This option controls if event handlers are printed to console.

config DESKTOP_EVENT_MANAGER_SHOW_LISTENERS
	bool "Show event listeners"
	default n
	help
	  Show listeners with events they subscribe to.

config DESKTOP_SYS_LOG_EVENT_MANAGER_LEVEL
	int "Event Manager log level: TODO"
	depends on SYS_LOG
	default 2
	range 0 4
	help
	  Sets log level for HID state.
	  Levels are:
	  - 0 OFF, do not write
	  - 1 ERROR, only write SYS_LOG_ERR
	  - 2 WARNING, write SYS_LOG_WRN in addition to previous level
	  - 3 INFO, write SYS_LOG_INF in addition to previous levels
	  - 4 DEBUG, write SYS_LOG_DBG in addition to previous levels
endmenu
```

## subsys/event_logger/Kconfig
```kconfig
menu "SysView profiler"

config SYSVIEW_INITIALIZATION
	bool "Initialize and config SystemView on start"
	default n
	select RTT_CONSOLE
	select SEGGER_SYSTEMVIEW

config SYSVIEW_LOG_KERNEL_EVENTS	
	bool "Log kernel events in SysView"
	depends on SYSVIEW_INITIALIZATION
	default n

config SYSVIEW_LOG_KERNEL_EVENTS_CONTEXT_SWITCH
	bool "Log context switch events"
	depends on SYSVIEW_LOG_KERNEL_EVENTS

config SYSVIEW_LOG_KERNEL_EVENTS_INTERRUPT
	bool "Log interrupt events"
	depends on SYSVIEW_LOG_KERNEL_EVENTS

config SYSVIEW_LOG_KERNEL_EVENTS_SLEEP
	bool "Log sleep events"
	depends on SYSVIEW_LOG_KERNEL_EVENTS

config SYSVIEW_LOG_KERNEL_EVENTS_THREAD
	bool "Log thread events"
	depends on SYSVIEW_LOG_KERNEL_EVENTS

config SYSVIEW_LOG_CUSTOM_EVENTS
	bool "Log custom events in SysView"
	depends on SYSVIEW_INITIALIZATION
	default n

config SYSVIEW_START_LOGGING_ON_SYSTEM_START
	bool "Start logging on system start"
	depends on SYSVIEW_INITIALIZATION
	default n

endmenu
```

## subsys/system_profiler/Kconfig
```kconfig
menu "System profiler"

config PROFILER
	bool"Enable system profiler"
	default n

config PROFILER_CUSTOM_EVENTS
	bool "Enable logging custom events"
	depends on PROFILER	
	default n

config PROFILER_CUSTOM_EVENTS_LOG_MEM_ADDR
	bool "Enable logging events' memory addresses"
	depends on PROFILER_CUSTOM_EVENTS
	default y

config PROFILER_CUSTOM_EVENT_BUF_LEN
	int "Length of data buffer for custom event data(in bytes)"
	depends on PROFILER_CUSTOM_EVENTS
	default 64

config MAX_NUMBER_OF_CUSTOM_EVENTS
	int "Maximum number of stored custom events"
	depends on PROFILER_CUSTOM_EVENTS
	default 32

config PROFILER_KERNEL_EVENTS
	bool "Enable logging kernel events"
	depends on PROFILER
	default n

config PROFILER_KERNEL_EVENTS_THREAD
	bool "Enable logging thread events"
	depends on PROFILER_KERNEL_EVENTS
	select KERNEL_EVENT_LOGGER_THREAD if PROFILER_SYSVIEW
	default n

config PROFILER_KERNEL_EVENTS_INTERRUPT
	bool "Enable logging interrupt events"
	depends on PROFILER_KERNEL_EVENTS
	select KERNEL_EVENT_LOGGER_INTERRUPT if PROFILER_SYSVIEW
	default n

config PROFILER_KERNEL_EVENTS_SLEEP
	bool "Enable logging sleep events"
	depends on PROFILER_KERNEL_EVENTS
	select KERNEL_EVENT_LOGGER_SLEEP if PROFILER_SYSVIEW
	default n

config PROFILER_KERNEL_EVENTS_CONTEXT_SWITCH
	bool "Log context switch events"
	depends on PROFILER_KERNEL_EVENTS
	select KERNEL_EVENT_LOGGER_CONTEXT_SWITCH if PROFILER_SYSVIEW
	default y

config PROFILER_SYSVIEW
	bool "Use SysView profiler"
	depends on PROFILER
	default y

menu "SysView advanced"
	depends on PROFILER_SYSVIEW
config SYSVIEW_INITIALIZATION
	bool "Initialize and config SystemView on start"
	default n
	select RTT_CONSOLE
	select SEGGER_SYSTEMVIEW

config SYSVIEW_LOG_KERNEL_EVENTS	
	bool "Log kernel events in SysView"
	select KERNEL_EVENT_LOGGER
	select TASK_MONITOR
	select THREAD_MONITOR
	select RING_BUFFER
	default n

config KERNEL_EVENT_LOGGER_BUFFER_SIZE
	int "Size of kernel event buffer"
	default 16


config SYSVIEW_START_LOGGING_ON_SYSTEM_START
	bool "Start logging on system start"
	depends on SYSVIEW_INITIALIZATION
	default n

endmenu #Advanced

config PROFILER_CUSTOM
	bool "Use custom profiler"
	depends on PROFILER
	default n

endmenu
```

## subsys/sysview_event_logger/Kconfig
```kconfig
menu "SysView profiler"

config SYSVIEW_INITIALIZATION
	bool "Initialize and config SystemView on start"
	default n
	select RTT_CONSOLE
	select SEGGER_SYSTEMVIEW

config SYSVIEW_LOG_KERNEL_EVENTS	
	bool "Log kernel events in SysView"
	depends on SYSVIEW_INITIALIZATION
	select KERNEL_EVENT_LOGGER
	select TASK_MONITOR
	select THREAD_MONITOR
	select RING_BUFFER
	default n

menu "Advanced"
	depends on SYSVIEW_LOG_KERNEL_EVENTS
	
config KERNEL_EVENT_LOGGER_BUFFER_SIZE
	int "Size of kernel event buffer"
	default 16

config SYSVIEW_LOG_KERNEL_EVENTS_CONTEXT_SWITCH
	bool "Log context switch events"
	select KERNEL_EVENT_LOGGER_CONTEXT_SWITCH
	default y

config SYSVIEW_LOG_KERNEL_EVENTS_INTERRUPT
	bool "Log interrupt events"
	select KERNEL_EVENT_LOGGER_INTERRUPT
	default n

config SYSVIEW_LOG_KERNEL_EVENTS_SLEEP
	bool "Log sleep events"
	select KERNEL_EVENT_LOGGER_SLEEP
	default n

config SYSVIEW_LOG_KERNEL_EVENTS_THREAD
	bool "Log thread events"
	depends on SYSVIEW_LOG_KERNEL_EVENTS
	select KERNEL_EVENT_LOGGER_THREAD
	default y

endmenu

config SYSVIEW_LOG_CUSTOM_EVENTS
	bool "Log custom events in SysView"
	depends on SYSVIEW_INITIALIZATION
	default n

config CUSTOM_EVENT_BUF_LEN
	int "Length of data buffer for custom event data(in bytes)"
	depends on SYSVIEW_LOG_CUSTOM_EVENTS
	default 64

config SYSVIEW_START_LOGGING_ON_SYSTEM_START
	bool "Start logging on system start"
	depends on SYSVIEW_INITIALIZATION
	default n

endmenu
```
